## drivers/voyager/sched/Kconfig
```kconfig
# SPDX-License-Identifier: GPL-2.0-only

config SCHED_EXT
	tristate "Support sched extention"
	help
	This will enable the features ported from the upstream.

config SCHED_EXT_DEBUG
	tristate "Support sched extention debug"
	help
	This will debug the features ported from the upstream.

config CPU_FREQ_DEFAULT_GOV_SCHEDUTIL_PLUS
	bool "schedutil_plus"
	depends on SCHED_EXT
	help
	  This will provide a improved version of schedutil governor.

config CPUFREQ_GOV_SCHEDUTIL_SINGLE_PERF
	tristate "'schedutil' extra function"
	depends on SCHED_EXT
	help
	  This will expand the functions of schedutil governor.

source "drivers/voyager/sched/walt/Kconfig"
```

## techpack/Kconfig
```kconfig
menu "Tech Packages"

source techpack/data/Kconfig

endmenu

config OSSFOD
	bool "OSS FOD support"
	depends on BOARD_XIAOMI && !MIHW
	help
	  When this option is enabled, OSS FOD support will be added.
	  
config DISABLE_MI_FOD_DIMLAYER
	bool "MI FOD switch"
	depends on BOARD_XIAOMI
	help
	  When this option is enabled, MI FOD dimlayer will be disabled.
```
